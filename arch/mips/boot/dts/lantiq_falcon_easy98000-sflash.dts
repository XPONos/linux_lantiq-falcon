/dts-v1/;

/include/ "falcon.dtsi"
/include/ "falcon_sflash.dtsi"

/ {
	model = "EASY98000 - Lantiq Falcon (SFLASH)";
	compatible = "lantiq,easy98000-sflash", "lantiq,easy98000", "lantiq,falcon";
	
	memory@0 {
		device_type = "memory";
		reg = <0x0 0x2000000>;
	};
	
	aliases {
		spi0 = &ebu_cs0;
	};
};
