## arch/mips/configs/lantiq_falcon_sfp_defconfig
```kconfig
CONFIG_LANTIQ=y
CONFIG_SOC_FALCON=y
CONFIG_DT_FALCONSFP=y
CONFIG_CPU_MIPS32_R2=y
CONFIG_MIPS_VPE_LOADER=y
# CONFIG_COMPACTION is not set
# CONFIG_CROSS_MEMORY_ATTACH is not set
# CONFIG_SECCOMP is not set
CONFIG_LANTIQ_IRQ_CACHE_OPTIMIZATION=y
CONFIG_BUILD_MIPS_UIMAGE_OVERRIDE_NAME=y
CONFIG_BUILD_MIPS_UIMAGE_NAME="Linux-3.10.108-XPONos"
CONFIG_BUILD_MIPS_UIMAGE_LZMA=y
CONFIG_LOCALVERSION="-xponos"
# CONFIG_SWAP is not set
CONFIG_SYSVIPC=y
CONFIG_HIGH_RES_TIMERS=y
CONFIG_IKCONFIG=y
CONFIG_IKCONFIG_PROC=y
CONFIG_UIDGID_STRICT_TYPE_CHECKS=y
# CONFIG_AIO is not set
CONFIG_EMBEDDED=y
# CONFIG_VM_EVENT_COUNTERS is not set
# CONFIG_COMPAT_BRK is not set
CONFIG_SLAB=y
CONFIG_MODULES=y
CONFIG_MODULE_UNLOAD=y
# CONFIG_BLK_DEV_BSG is not set
CONFIG_PARTITION_ADVANCED=y
# CONFIG_IOSCHED_CFQ is not set
# CONFIG_CORE_DUMP_DEFAULT_ELF_HEADERS is not set
# CONFIG_SUSPEND is not set
CONFIG_NET=y
CONFIG_PACKET=y
CONFIG_UNIX=y
CONFIG_INET=y
CONFIG_IP_MULTICAST=y
CONFIG_IP_ADVANCED_ROUTER=y
CONFIG_IP_MULTIPLE_TABLES=y
CONFIG_IP_ROUTE_MULTIPATH=y
CONFIG_IP_ROUTE_VERBOSE=y
CONFIG_IP_MROUTE=y
CONFIG_IP_MROUTE_MULTIPLE_TABLES=y
CONFIG_ARPD=y
CONFIG_SYN_COOKIES=y
# CONFIG_INET_XFRM_MODE_TRANSPORT is not set
# CONFIG_INET_XFRM_MODE_TUNNEL is not set
# CONFIG_INET_XFRM_MODE_BEET is not set
# CONFIG_INET_LRO is not set
# CONFIG_INET_DIAG is not set
CONFIG_TCP_CONG_ADVANCED=y
# CONFIG_TCP_CONG_BIC is not set
# CONFIG_TCP_CONG_WESTWOOD is not set
# CONFIG_TCP_CONG_HTCP is not set
# CONFIG_IPV6 is not set
CONFIG_BRIDGE=y
CONFIG_VLAN_8021Q=y
# CONFIG_WIRELESS is not set
# CONFIG_FIRMWARE_IN_KERNEL is not set
CONFIG_MTD=y
CONFIG_MTD_CMDLINE_PARTS=y
CONFIG_MTD_BLOCK=y
CONFIG_MTD_ROOTFS_ROOT_DEV=y
CONFIG_MTD_ROOTFS_SPLIT=y
CONFIG_MTD_UIMAGE_SPLIT=y
CONFIG_MTD_UIMAGE_SPLIT_PARTITION_NAME="linux"
CONFIG_MTD_CFI=y
CONFIG_MTD_JEDECPROBE=y
CONFIG_MTD_CFI_ADV_OPTIONS=y
CONFIG_MTD_CFI_GEOMETRY=y
CONFIG_MTD_CFI_INTELEXT=y
CONFIG_MTD_CFI_AMDSTD=y
CONFIG_MTD_COMPLEX_MAPPINGS=y
CONFIG_MTD_PHYSMAP_OF=y
CONFIG_MTD_LANTIQ=y
CONFIG_MTD_M25P80=y
CONFIG_MTD_NAND=y
CONFIG_MTD_NAND_FALCON=y
CONFIG_PROC_DEVICETREE=y
CONFIG_NETDEVICES=y
CONFIG_MII=y
# CONFIG_NET_VENDOR_WIZNET is not set
CONFIG_PHYLIB=y
# CONFIG_WLAN is not set
# CONFIG_INPUT is not set
# CONFIG_SERIO is not set
# CONFIG_VT is not set
# CONFIG_LEGACY_PTYS is not set
# CONFIG_DEVKMEM is not set
CONFIG_SERIAL_LANTIQ=y
CONFIG_HW_RANDOM=y
CONFIG_I2C=y
# CONFIG_I2C_COMPAT is not set
CONFIG_I2C_CHARDEV=y
# CONFIG_I2C_HELPER_AUTO is not set
CONFIG_SPI=y
CONFIG_SPI_FALCON=y
CONFIG_GPIO_SYSFS=y
# CONFIG_HWMON is not set
CONFIG_WATCHDOG=y
CONFIG_LANTIQ_WDT=y
# CONFIG_USB_SUPPORT is not set
CONFIG_NEW_LEDS=y
CONFIG_LEDS_CLASS=y
CONFIG_LEDS_GPIO=y
CONFIG_LEDS_TRIGGERS=y
CONFIG_LEDS_TRIGGER_TIMER=y
CONFIG_LEDS_TRIGGER_DEFAULT_ON=y
# CONFIG_IOMMU_SUPPORT is not set
# CONFIG_DNOTIFY is not set
# CONFIG_PROC_PAGE_MONITOR is not set
CONFIG_TMPFS=y
CONFIG_TMPFS_XATTR=y
CONFIG_JFFS2_FS=y
CONFIG_JFFS2_SUMMARY=y
CONFIG_JFFS2_FS_XATTR=y
# CONFIG_JFFS2_FS_POSIX_ACL is not set
# CONFIG_JFFS2_FS_SECURITY is not set
CONFIG_JFFS2_COMPRESSION_OPTIONS=y
# CONFIG_JFFS2_ZLIB is not set
CONFIG_SQUASHFS=y
CONFIG_SQUASHFS_XATTR=y
# CONFIG_SQUASHFS_ZLIB is not set
CONFIG_SQUASHFS_XZ=y
# CONFIG_NETWORK_FILESYSTEMS is not set
CONFIG_PRINTK_TIME=y
# CONFIG_ENABLE_MUST_CHECK is not set
CONFIG_MAGIC_SYSRQ=y
CONFIG_STRIP_ASM_SYMS=y
CONFIG_DEBUG_FS=y
# CONFIG_SCHED_DEBUG is not set
CONFIG_DEBUG_INFO=y
CONFIG_DEBUG_INFO_REDUCED=y
# CONFIG_FTRACE is not set
CONFIG_CC_WERROR=y
# CONFIG_CRYPTO_ANSI_CPRNG is not set
# CONFIG_CRYPTO_HW is not set
CONFIG_CRC32_SARWATE=y
```

## arch/mips/lantiq/Kconfig
```kconfig
if LANTIQ

config SOC_TYPE_XWAY
	bool
	select PINCTRL_XWAY
	default n

choice
	prompt "SoC Type"
	default SOC_XWAY

config SOC_AMAZON_SE
	bool "Amazon SE"
	select SOC_TYPE_XWAY

config SOC_XWAY
	bool "XWAY"
	select SOC_TYPE_XWAY
	select HW_HAS_PCI

config SOC_FALCON
	bool "FALCON"
	select PINCTRL_FALCON

endchoice

choice
	prompt "Devicetree"

config DT_EASY50712
	bool "Easy50712"
	depends on SOC_XWAY
	select BUILTIN_DTB
	
config DT_EASY98000NOR
	bool "EASY98000 - Lantiq Falcon (NOR)"
	depends on SOC_FALCON
	select BUILTIN_DTB
	
config DT_EASY98000SFLASH
	bool "EASY98000 - Lantiq Falcon (SFLASH)"
	depends on SOC_FALCON
	select BUILTIN_DTB
	
config DT_FALCONSFP
	bool "SFP - Lantiq Falcon SFP Stick"
	depends on SOC_FALCON
	select BUILTIN_DTB
endchoice

config PCI_LANTIQ
	bool "PCI Support"
	depends on SOC_XWAY && PCI

config XRX200_PHY_FW
	bool "XRX200 PHY firmware loader"
	depends on SOC_XWAY

endif

config FALCON_COMPAT_SYSCTRL
	bool "Enable Falcon compat sysctrl"
	depends on SOC_FALCON
	default n
	

config FALCON_TIMER
	bool "Enable Falcon timer clocksource"
	depends on FALCON_COMPAT_SYSCTRL
	default n
	help 
	  Enable the GPTC timer of SOC Falcon, it is more accurate than MIPS source.
```

## drivers/staging/ifxos/Kconfig
```kconfig
menuconfig LANTIQ_IFXOS
	tristate "Lantiq IFXOS"
	depends on LANTIQ
	default n
	---help---
	  The Lantiq IFXOS kernel module is required for 
	  Lantiq DSL/ONU GPON drivers. If in doubt, say N here.
	  
if LANTIQ_IFXOS	
	
config LANTIQ_IFXOS_EVENT
	bool "Enable IFXOS event support"
	depends on LANTIQ_IFXOS
	default y
	
config LANTIQ_IFXOS_LOCK
	bool "Enable IFXOS lock support"
	depends on LANTIQ_IFXOS_EVENT
	default y
	
config LANTIQ_IFXOS_NAMED_LOCK
	bool "Enable IFXOS named lock support"
	depends on LANTIQ_IFXOS_LOCK
	default y
	
config LANTIQ_IFXOS_LOCK_TIMEOUT
	bool "Enable IFXOS lock timeout support"
	depends on LANTIQ_IFXOS_LOCK
	default y
	
config LANTIQ_IFXOS_BLOCK_ALLOC
	bool "Enable IFXOS block alloc support"
	depends on LANTIQ_IFXOS
	select LANTIQ_IFXOS_MEMORY
	default y
	
config LANTIQ_IFXOS_MEMORY_LOCAL_CHECK
	bool "Enable IFXOS local check support"
	depends on LANTIQ_IFXOS_BLOCK_ALLOC
	default n
	
config LANTIQ_IFXOS_MEM_ALLOC
	bool "Enable IFXOS mem alloc support"
	depends on LANTIQ_IFXOS
	select LANTIQ_IFXOS_MEMORY
	default y
	
config LANTIQ_IFXOS_MEMORY
	bool
	default n
	depends on LANTIQ_IFXOS
	
config LANTIQ_IFXOS_MUTEX
	bool "Enable IFXOS mutex support"
	depends on LANTIQ_IFXOS
	default y
	
config LANTIQ_IFXOS_SELECT
	bool "Enable IFXOS SELECT handling support"
	depends on LANTIQ_IFXOS
	default y
	
config LANTIQ_IFXOS_SOCKET
	bool "Enable IFXOS socket support"
	depends on LANTIQ_IFXOS
	default y	
	
config LANTIQ_IFXOS_SOCKET_IPV6
	bool "Enable IFXOS IPv6 socket support"
	depends on LANTIQ_IFXOS_SOCKET
	default n
	
config LANTIQ_IFXOS_TIME_SLEEP_US
	bool "Enable IFXOS time sleep in us support"
	depends on LANTIQ_IFXOS
	select LANTIQ_IFXOS_TIME
	default y
	
config LANTIQ_IFXOS_TIME_SLEEP_MS
	bool "Enable IFXOS time sleep in ms support"
	depends on LANTIQ_IFXOS
	select LANTIQ_IFXOS_TIME
	default y
	
config LANTIQ_IFXOS_TIME_ELAPSED_TIME_GET_MS
	bool "Enable IFXOS get elapesed time in ms support"
	depends on LANTIQ_IFXOS
	select LANTIQ_IFXOS_TIME
	default y
	
config LANTIQ_IFXOS_TIME
	bool
	default n
	depends on LANTIQ_IFXOS
	
config LANTIQ_IFXOS_THREAD
	bool "Enable IFXOS thread support"
	depends on LANTIQ_IFXOS_TIME_SLEEP_MS
	default y
	
endif # LANTIQ_IFXOS
```
